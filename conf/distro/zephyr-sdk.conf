## conf/distro/zephyr-sdk.conf
```bitbake
require conf/distro/poky.conf
require include/zephyr-sdk.inc

DISTRO_VERSION = "0.8"
PACKAGE_CLASSES = "package_ipk"
```

## conf/machine/arc.conf
```bitbake
require conf/machine/arch-arc.inc

PREFERRED_VERSION_gcc-cross-${TARGET_ARCH} ?= "4.8.5+gitarc"
PREFERRED_VERSION_gcc-cross-canadian-${TRANSLATED_TARGET_ARCH} ?= "4.8.5+gitarc"
PREFERRED_VERSION_libgcc ?= "4.8.5+gitarc"
PREFERRED_VERSION_binutils-cross-${TARGET_ARCH} ?= "2.23+gitarc"
PREFERRED_VERSION_binutils-cross-canadian-${TRANSLATED_TARGET_ARCH} ?= "2.23+gitarc"
PREFERRED_VERSION_gdb-cross-canadian-${TRANSLATED_TARGET_ARCH} ?= "7.5.1+gitarc"

TARGET_LINK_HASH_STYLE = ""
```

## conf/machine/arch-arc.inc
```bitbake
DEFAULTTUNE ?= "arc"

TUNE_ARCH = "arc"
TUNE_PKGARCH = "arc"
TUNE_FEATURES_tune-arc = "littleendian"
#This does not work for multilib
#TUNE_CCARGS = "-mARCv2EM -mav2em"
TUNE_CCARGS = ""

#TUNEVALID[bigendian] = "Big endian mode"
TUNEVALID[littleendian] = "Little endian mode"
#TUNE_CCARGS .= "${@bb.utils.contains("TUNE_FEATURES", "bigendian", " -EB", " -EL", d)}"
#TUNE_ARCH = "${@bb.utils.contains("TUNE_FEATURES", "bigendian", "arceb", "arc", d)}"
```

## conf/machine/arch-iamcu.inc
```bitbake
DEFAULTTUNE ?= "iamcu"

TARGET_OS_iamcu = "elfiamcu"
TARGET_VENDOR_iamcu = "-poky"
TARGET_SYS_iamcu = "i586-poky-elfiamcu"

TUNE_ARCH = "iamcu"
TUNE_PKGARCH = "iamcu"
TUNE_FEATURES_tune-iamcu = "iamcu"
TUNE_CCARGS = "-miamcu -m32"

TUNEVALID[iamcu] = "Intel MCU"
```

## conf/machine/arch-nios2.inc
```bitbake
# Nios2 Architecture Definition

DEFAULTTUNE ?= "nios2"

TUNE_ARCH = "nios2"
TUNE_PKGARCH = "nios2"
TUNE_FEATURES_tune-nios2 = "nios2"

TUNEVALID[nios2] = "Altera Nios2"
```

## conf/machine/iamcu.conf
```bitbake
require conf/machine/arch-iamcu.inc

PREFERRED_VERSION_gcc-cross-${TARGET_ARCH} ?= "4.sc+gitiamcu"
PREFERRED_VERSION_gcc-cross-canadian-${TRANSLATED_TARGET_ARCH} ?= "4.sc+gitiamcu"
PREFERRED_VERSION_libgcc ?= "4.sc+gitiamcu"
PREFERRED_VERSION_binutils-cross-${TARGET_ARCH} ?= "i2.25+gitiamcu"
PREFERRED_VERSION_binutils-cross-canadian-${TRANSLATED_TARGET_ARCH} ?= "i2.25+gitiamcu"

TARGET_LINK_HASH_STYLE = ""
#STAGING_BINDIR_TOOLCHAIN = "${STAGING_DIR_NATIVE}${bindir_native}/i586${TARGET_VENDOR}-${TARGET_OS}"
```
